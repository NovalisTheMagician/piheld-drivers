// SPDX-License-Identifier: GPL-2.0
/dts-v1/;
/plugin/;

/{
	compatible = "brcm,bcm2835";

	fragment@0 {
		target = <&i2c1>;

		__overlay__ {
			#address-cells = <1>;
			#size-cells = <0>;
			stc3100: stc3100@70 {
				compatible = "st,stc3100";
				reg = <0x70>;
				capacity = <2500>;
			};
		};
	};
};

